## CMakeLists.txt
```
# SPDX-License-Identifier: Apache-2.0

cmake_minimum_required(VERSION 3.13.1)
find_package(Zephyr REQUIRED HINTS $ENV{ZEPHYR_BASE})
project(RTES-Shankar-R_04)

target_sources(app PRIVATE src/main.c)
```

## prj.conf
```kconfig
CONFIG_PRINTK=y
CONFIG_LOG=n
# CONFIG_SHELL=y
CONFIG_SEGGER_SYSTEMVIEW=y
CONFIG_USE_SEGGER_RTT=y
CONFIG_TRACING=y
CONFIG_THREAD_NAME=y
CONFIG_STDOUT_CONSOLE=y
CONFIG_SCHED_CPU_MASK=y
CONFIG_DEBUG_THREAD_INFO=y
CONFIG_NEWLIB_LIBC=y
```

## src/main.c
```c
#include <zephyr.h>
#include <kernel.h>
#include <sys/printk.h>
#include <sys/util.h>
#include <stdbool.h>
#include <stdlib.h>
#include "task_model_p4.h"
#include <timing/timing.h>
#include <shell/shell_uart.h>
#include <logging/log.h>
#include <sys/time_units.h>
LOG_MODULE_REGISTER(main, LOG_LEVEL_DBG);


// Global flag threads use to determine if to stop running
static bool running = true;

struct k_timer budget_timer;

// k_thread structures / data
static struct k_thread thread_structs[NUM_THREADS+1];
static k_tid_t thread_tids[NUM_THREADS+1];

static int thread_index[NUM_THREADS+1];

static int done[NUM_THREADS+1];
static struct k_sem wait_sem[NUM_THREADS+1];

// Support up to sixteen threads' stacks
K_THREAD_STACK_DEFINE(thread_stack_area, STACK_SIZE * NUM_THREADS+1);

K_THREAD_STACK_DEFINE(my_stack_area, 128);

struct k_work priority_low_work, priority_high_work;

uint64_t t_resp=0;

static struct req_type data;

uint32_t ctr=0;

static struct k_sem cmd_sem;

void aperiodic_switched_in(){
    if(k_current_get()==thread_tids[NUM_THREADS] && poll_info.left_budget > 0){
        // start budget timer with left budget
        k_timer_start(&budget_timer,K_NSEC(poll_info.left_budget), K_NSEC(poll_info.left_budget));
    }
}

void aperiodic_switched_out(){
    if(k_current_get()==thread_tids[NUM_THREADS] && poll_info.left_budget > 0){
        // calculate left budget and stop the budget timer
        poll_info.left_budget = 1000000*k_timer_remaining_get(&budget_timer);
        k_timer_stop(&budget_timer);
    }
}

static void timer_expiry_function(struct k_timer *timer_exp)
{
    int id = *(int *)timer_exp->user_data;
    int ret;
    if(id==NUM_THREADS){
        poll_info.left_budget = 1000000*BUDGET;
        k_work_submit(&priority_high_work);
    }
    ret = done[id];  
    if (ret==1) {
        k_sem_give(&wait_sem[id]);
    }
    else {
        //LOG_DBG("task %d misses its deadline \n", id);
        k_sem_give(&wait_sem[id]);
    }
}

void priority_low_function(){
    // Decrease priority
    k_thread_priority_set(thread_tids[NUM_THREADS], 14);
} 

void priority_high_function(){
    // Increase priority
    k_thread_priority_set(thread_tids[NUM_THREADS], poll_info.priority);
} 

static void budget_expiry_function(struct k_timer *timer_exp)
{
    // make left budget zero and reduce priority 
    poll_info.left_budget = 0;
    k_timer_stop(&budget_timer);
    k_work_submit(&priority_low_work);
}

// Function that is executed for each thread in the task set
static void thread_execute_periodic(void *v_task_info, void *v_thread_id, void *unused)
{
    //wait for activation input from shell command
    k_sem_take(&cmd_sem, K_FOREVER);

    struct task_s *task_info = (struct task_s *)v_task_info;
    int thread_id = *(int *)v_thread_id; 
 
	uint32_t period;

    struct k_timer task_timer;

    k_timer_init(&task_timer, timer_expiry_function, NULL);
    task_timer.user_data = v_thread_id;

    
    LOG_DBG("task %d gets started \n", thread_id);
	period = 1000000*task_info->period; 

    k_timer_start(&task_timer,K_NSEC(period), K_NSEC(period));

    while (running) {

        looping(task_info->loop_iter);

        done[thread_id]=1;
        
        k_sem_take(&wait_sem[thread_id], K_FOREVER);
    }
    k_timer_stop(&task_timer);
}

// polling server

static void thread_execute_aperiodic(void *a_task_info, void *v_thread_id, void *unused)
{   

    //wait for activation input from shell command
    k_sem_take(&cmd_sem, K_FOREVER);

    struct task_aps *task_info = (struct task_aps *)a_task_info;
    int thread_id = *(int *)v_thread_id; 

    LOG_DBG("Thread id: %d\n", thread_id);
	uint32_t period;

    struct k_timer task_timer;
    
    k_timer_init(&task_timer, timer_expiry_function, NULL);
    task_timer.user_data = v_thread_id;
    uint32_t end = 0;
    LOG_DBG("task %d gets started \n", thread_id);
	period = 1000000*task_info->period; 
    
    k_timer_start(&task_timer,K_NSEC(period), K_NSEC(period));
    
    memset(&data, 0, sizeof(struct req_type));
    
    while(running) {
        while(1){
            if(!running){
                break;
            }
            if(!k_msgq_get(&req_msgq, &data, K_NO_WAIT)){
                // if active and budget remaining
                if(poll_info.left_budget>0){
                    ctr++;
                    k_timer_start(&budget_timer, K_NSEC(poll_info.left_budget),K_NO_WAIT);
                    looping(data.iterations);
                    end = k_cycle_get_32();
                    t_resp+=sub32(data.arr_time, end);
                    poll_info.left_budget = 1000000*k_timer_remaining_get(&budget_timer);
                }
                // if in background
                else{
                    ctr++;
                    looping(data.iterations);
                    end = k_cycle_get_32();
                    t_resp+=sub32(data.arr_time, end);
                }

            }
           // make bg when queue is empty
           else{
               k_timer_stop(&budget_timer);
               poll_info.left_budget = 0;
               k_work_submit(&priority_low_work);
           } 
                
        }
    }
    t_resp = k_cyc_to_ms_near64(t_resp);

    k_timer_stop(&budget_timer);
    k_timer_stop(&task_timer);
}

// Start all threads defined in the task set
static void start_threads(void)
{
    k_sem_init(&cmd_sem,0,NUM_THREADS+1);
	    
    for (int i = 0; i < NUM_THREADS+1; i++) {
        k_sem_init(&wait_sem[i], 0, 1);
        done[i]=0;
    }

    // Small delay to make sure we set each thread's name before it runs

    // Start each thread
    for (int i = 0; i < NUM_THREADS; i++) {
		thread_index[i]=i;
        thread_tids[i] = k_thread_create(&thread_structs[i],
                                         &thread_stack_area[STACK_SIZE * i],
                                         STACK_SIZE * sizeof(k_thread_stack_t),
                                         thread_execute_periodic, (void *)&threads[i],
                                         (void *)&thread_index[i], NULL, threads[i].priority,
                                         0, K_MSEC(10));

        k_thread_name_set(thread_tids[i], threads[i].t_name);

    }

    thread_index[NUM_THREADS]=NUM_THREADS;
    thread_tids[NUM_THREADS] = k_thread_create(&thread_structs[NUM_THREADS],
                                         &thread_stack_area[STACK_SIZE * NUM_THREADS],
                                         STACK_SIZE * sizeof(k_thread_stack_t),
                                         thread_execute_aperiodic, (void *)&poll_info,
                                         (void *)&thread_index[NUM_THREADS], NULL, poll_info.priority,
                                         0, K_MSEC(10));

    poll_info.poll_tid = thread_tids[NUM_THREADS];

    k_thread_name_set(thread_tids[NUM_THREADS], poll_info.t_name);


    //printk("Threads Initialized!\n");
    LOG_DBG("Threads Initialized!\n");
}

// "Entry point" of our code
void main(void)
{   
    k_timer_init(&budget_timer, budget_expiry_function, NULL);
    k_work_init(&priority_low_work, priority_low_function);
    k_work_init(&priority_high_work, priority_high_function);
    // Spawn the threads
    start_threads();

    // start request timer
    k_timer_start(&req_timer, K_USEC(ARR_TIME), K_NO_WAIT); 

    for(int i=0;i<NUM_THREADS+1;i++){
        k_sem_give(&cmd_sem);
    }

    k_sleep(K_MSEC(TOTAL_TIME));

    k_timer_stop(&req_timer);
    // Stop the threads!
    running = false;

    //terminate waiting threads waiting on semaphore
    for (int i = 0; i < NUM_THREADS+1; ++i) {
        k_sem_give(&wait_sem[i]);
    }

    //wait for threads to exit
    for (int i = 0; i < NUM_THREADS+1; ++i) {
        k_thread_join(&thread_structs[i],K_FOREVER);
    }

    printk("Average response time: %lld\n", (t_resp/ctr));
    printk("no.of requests processed: %d\n", ctr);

    LOG_DBG("Stopped threads\n");
}
```

## src/task_model_p4.h
```c
#ifndef __TASK_MODEL_H__
#define __TASK_MODEL_H__

/*
 * 
 */
//#define DEBUG 

#if defined(DEBUG) 
	#define DPRINTK(fmt, args...) printk("DEBUG: %s():%d: " fmt, \
   		 __func__, __LINE__, ##args)
#else
 	#define DPRINTK(fmt, args...) // do nothing if not defined
#endif

#define compiler_barrier() do { \
	__asm__ __volatile__ ("" ::: "memory"); \
} while (false)

#define STACK_SIZE  4096

#define NUM_THREADS	4		// number of threads
#define TOTAL_TIME 6000  	// total execution time in milliseconds
#define MAX_RECORD 200

struct task_s           // struct for periodic task
{
	char t_name[32]; 	// task name
	int priority; 		// priority of the task
	int period; 		// period for periodic task in milliseconds
	int loop_iter; 	   // loop iterations for compute
};

#define THREAD0 {"task00", 5, 50, 1680000}
#define THREAD1 {"task11", 8, 160, 3500000}
#define THREAD2 {"task22", 9, 220, 3640000}
#define THREAD3 {"task33", 10, 360, 3640000}

struct task_s threads[NUM_THREADS]={THREAD0, THREAD1, THREAD2, THREAD3};

struct task_aps         // struct for polling server
{
	char t_name[32]; 	// task name
	int priority; 		// assigned priority of the task
	int period; 		// replenishment period for polling task in milliseconds
	int budget; 		// budget of polling task in milliseconds
	k_tid_t poll_tid;   // thread id for the polling server
	uint32_t last_switched_in;     
	int left_budget;		// remaining budget in nanoseconds
};

#define POLL_PRIO   6   // > 10 for background server only.
#define BUDGET 40       // execution budget for polling server in milliseconds
                        // an alternate budget is 25

struct task_aps poll_info = {"polling_t", POLL_PRIO, 120, BUDGET, NULL, 0, 1000000*BUDGET};

struct req_type {       // struct for aperiodic requests
    uint32_t id;
    uint32_t iterations;    // loop iterations for compute
    uint32_t arr_time;      // the arrival time of the request
};

static void req_expiry_function(struct k_timer *timer_exp);

K_MSGQ_DEFINE(req_msgq, sizeof(struct req_type), 20, 4);
K_TIMER_DEFINE(req_timer, req_expiry_function, NULL);

// variance to generate random numbers
#define VAR_R    0
#define VAR_A    0.4
#define VAR_L    0.5

// Loop to emulate task execution
void looping(int loop_count) 
{
    volatile int t1 = loop_count;

    while (t1 > 0) t1--;
    compiler_barrier();
}

// generate random number between base*(1-var) and base
static uint32_t rand_dist(int base, float var)  
{
    int iter;
    int range;

    range = base*var;
    iter = base; 
    if (range > 0) {
        iter = iter * (1-var) + rand() % range;
    }
    return iter;

}

// end-start, if end < start, add overflow
uint64_t sub32(uint32_t start, uint32_t end)  
{  
    uint64_t a, b;

    a = (uint64_t) start;
    b = (uint64_t) end;

    if (b>a) 
            return (b-a);
    else {
        return ((b + (((uint64_t) 1)<<32)) -a);
    }
}

#define ARR_TIME 40000      // interarrival time of aperiodic requests in microseconds 150000
#define REQ_LOOP 1250000     // aperiodic request loop count 420000
int total_req=0;

// Timer callback function to generate aperiodic requests
static void req_expiry_function(struct k_timer *timer_exp)
{
    uint32_t stime;
    struct req_type data;

    data.id = total_req;
    data.iterations = rand_dist(REQ_LOOP, VAR_R);
    data.arr_time = k_cycle_get_32();
    k_msgq_put(&req_msgq, &data, K_NO_WAIT);
    
    total_req++;

    stime = rand_dist(ARR_TIME, VAR_A);
    k_timer_start(&req_timer, K_USEC(stime), K_NO_WAIT);

}

#endif // __TASK_MODEL_H__
```
